//Bibliotecas
#include <Arduino.h>
#include <U8g2lib.h>
#include <Bounce2.h>
#include <Wire.h>
#include <Adafruit_GFX.h>
#include <Adafruit_SSD1306.h>

//Definições
#define Botao 19
#define SCREEN_WIDTH 128 
#define SCREEN_HEIGHT 64 
#define SCREEN_ADDRESS 0x3C 
#define OLED_RESET -1

//Objetos
U8G2_SSD1306_128X64_NONAME_F_HW_I2C u8g2(U8G2_R0, U8X8_PIN_NONE);
				Bounce2::Button botao = Bounce2::Button(); 

//instancia
Adafruit_SSD1306 oled(SCREEN_WIDTH, SCREEN_HEIGHT, &Wire, OLED_RESET);

//Variaveis
bool ativacao = 1;
int posicao = 0;

// 'mapa7', 128x64px
const unsigned char mapa7 [] PROGMEM = {
	0xff, 0xff, 0xff, 0xff, 0xff, 0xff, 0xff, 0xff, 0xff, 0xff, 0xff, 0xff, 0xff, 0xff, 0xff, 0xff, 
	0xfc, 0xff, 0xff, 0xff, 0xff, 0xfc, 0x00, 0x01, 0xff, 0xff, 0xff, 0xf8, 0x00, 0x00, 0x00, 0x3f, 
	0xe0, 0x00, 0x00, 0x00, 0x00, 0x00, 0x00, 0x00, 0x00, 0x00, 0x00, 0x00, 0x00, 0x00, 0x00, 0x0f, 
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	0xff, 0xfe, 0xff, 0xff, 0xff, 0xff, 0xff, 0xff, 0xff, 0xff, 0xff, 0xff, 0xff, 0xff, 0xff, 0xff
};

//prototipo
void inicio(void);
void principal(void);
void final(void);
void atualizaBotao(void);
float lerTemperatura(void);
float lerUmidade(void);

void setup() 
{
  u8g2.begin();
  botao.attach(Botao, INPUT_PULLUP);
  botao.setPressedState(LOW);
  oled.begin(SSD1306_SWITCHCAPVCC, SCREEN_ADDRESS);
}

void loop() 
{
  atualizaBotao();
  if (posicao == 0)
    inicio();
  if (posicao == 1)
    principal();
    if(posicao == 2)
    final();
}

void inicio()

{
  u8g2.clearBuffer();
  u8g2.drawRFrame(0, 0, 126, 62, 2); 
  u8g2.setFont(u8g2_font_sisterserif_tr);
  u8g2.drawStr(15, 25, "Ola seja bem ");
  u8g2.drawStr(30, 45, "vindo(a)!");
  u8g2.sendBuffer();
}

void atualizaBotao()

{
  botao.update();
  if (botao.pressed())
  {
    posicao = posicao + 1;
    if (posicao > 2)
      posicao = 0;
  }
}

void principal()

{
  u8g2.clearBuffer();
  u8g2.drawRFrame(0, 0, 126, 62, 2); 
  u8g2.setFont(u8g2_font_efraneextracondensed_te);
  u8g2.drawStr(15, 25, "Aperte o botão para");
  u8g2.drawStr(25, 45, "direcionamento");
  u8g2.sendBuffer();
}

void final()

{
  oled.clearDisplay();
  oled.drawBitmap(0,0, mapa7, 128,64, WHITE);
  oled.display();
}